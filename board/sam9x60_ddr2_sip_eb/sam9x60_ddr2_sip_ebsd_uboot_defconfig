## board/sam9x60_ddr2_sip_eb/sam9x60_ddr2_sip_ebsd_uboot_defconfig
```kconfig
CONFIG_SAM9X60_DDR2_SIP_EB=y
CONFIG_RAM_64MB=y
CONFIG_SDCARD=y
CONFIG_DEBUG=y
CONFIG_THUMB=y
CONFIG_SCLK_INTRC=y
# CONFIG_LOAD_ONE_WIRE is not set
# CONFIG_LOAD_EEPROM is not set
```
